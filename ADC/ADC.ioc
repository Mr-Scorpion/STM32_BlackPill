# file: ADC.ioc
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Mcu.Family=STM32F4
Mcu.Name=STM32F401R(B-C)Tx
Mcu.Package=LQFP64
NVIC.PriorityGroup=NVIC_PRIORITYGROUP_4
ProjectManager.HeapSize=0x200
ProjectManager.StackSize=0x400
ProjectManager.TargetToolchain=STM32CubeIDE
RCC.AHBFreq_Value=16000000
RCC.APB1Freq_Value=16000000
RCC.APB2Freq_Value=16000000
RCC.CortexFreq_Value=16000000
RCC.HSE_VALUE=25000000
RCC.HSI_VALUE=16000000
RCC.LSE_VALUE=32768
RCC.SYSCLKFreq_VALUE=16000000
RCC.VCOOutputFreq_Value=192000000
board=custom

// file: Core/Src/main.c
/* USER CODE BEGIN Header */
/**
  ******************************************************************************
  * @file           : main.c
  * @brief          : Main program body
  ******************************************************************************
  * @attention
  *
  * Copyright (c) 2025 STMicroelectronics.
  * All rights reserved.
  *
  * This software is licensed under terms that can be found in the LICENSE file
  * in the root directory of this software component.
  * If no LICENSE file comes with this software, it is provided AS-IS.
  *
  ******************************************************************************
  */
/* USER CODE END Header */
#include "main.h"

/* USER CODE BEGIN PD */
uint16_t ADC_Read(void)
{
	ADC1->CR2 |= ADC_CR2_SWSTART;
	while(!(ADC1->SR & ADC_SR_EOC));
	return (uint16_t)ADC1->DR;
}
static uint16_t adc_value1, adc_value2;
// Define ADC Channel for PA0 (ADC Channel 0)

/* USER CODE END PD */

void SystemClock_Config(void);

int main(void)
{

  /* MCU Configuration--------------------------------------------------------*/

  /* Reset of all peripherals, Initializes the Flash interface and the Systick. */
  HAL_Init();

  /* Configure the system clock */
  SystemClock_Config();

  /* Initialize all configured peripherals */
  /* USER CODE BEGIN 2 */
  __HAL_RCC_GPIOA_CLK_ENABLE();

     __HAL_RCC_ADC1_CLK_ENABLE();

     	 GPIO_InitTypeDef GPIO_InitStruct = {0};
     	 GPIO_InitStruct.Pin = GPIO_PIN_0|GPIO_PIN_1;
       GPIO_InitStruct.Mode = GPIO_MODE_ANALOG;
       GPIO_InitStruct.Pull = GPIO_NOPULL;
       GPIO_InitStruct.Speed = GPIO_SPEED_FREQ_LOW;
       HAL_GPIO_Init(GPIOA, &GPIO_InitStruct);

       ADC->CCR |= 1<<16;// PCLK2 divide by 4
       ADC1->CR2 = 0;
       ADC1->CR1 = (1<<8);//enable scan mode for multiple channel
       ADC1->CR2 |= ADC_CR2_ADON;// A2D on
       ADC1->CR2 |= ADC_CR2_CONT;// continuous mode
       ADC1->SQR1 = (1 << 20); // Two conversions (L = N-1, so 2-1 = 1)
       ADC1->SQR3 = (0 << 0) | (1 << 5); // First conversion: Channel 0, Second conversion: Channel 1
       ADC1->SMPR2 = (1 << (0 * 3)) | (1 << (1 * 3)); // Sampling time for both channels
       ADC1->CR2 |= (1<<10);    			   // EOC after each conversion

    /* USER CODE END 2 */

    /* Infinite loop */
    while (1)
    {
  	  // Start ADC
  	  	   ADC1->SR = 0;
  	       ADC1->CR2 |= ADC_CR2_SWSTART;

  	  // Wait until the conversion is complete
  	          while (!(ADC1->SR & ADC_SR_EOC));
  	          // Read ADC results from DR register
  	          adc_value1 = ADC1->DR;  // Read PA0 (First conversion)

  	          while (!(ADC1->SR & ADC_SR_EOC));  // Wait for second conversion
  	          adc_value2 = ADC1->DR;  // Read PA1 (Second conversion)

  	          HAL_Delay(10);
    }
  }
void SystemClock_Config(void)
{
  RCC_OscInitTypeDef RCC_OscInitStruct = {0};
  RCC_ClkInitTypeDef RCC_ClkInitStruct = {0};

  /** Configure the main internal regulator output voltage
  */
  __HAL_RCC_PWR_CLK_ENABLE();
  __HAL_PWR_VOLTAGESCALING_CONFIG(PWR_REGULATOR_VOLTAGE_SCALE2);

  /** Initializes the RCC Oscillators according to the specified parameters
  * in the RCC_OscInitTypeDef structure.
  */
  RCC_OscInitStruct.OscillatorType = RCC_OSCILLATORTYPE_HSI;
  RCC_OscInitStruct.HSIState = RCC_HSI_ON;
  RCC_OscInitStruct.HSICalibrationValue = RCC_HSICALIBRATION_DEFAULT;
  RCC_OscInitStruct.PLL.PLLState = RCC_PLL_NONE;
  if (HAL_RCC_OscConfig(&RCC_OscInitStruct) != HAL_OK)
  {
    Error_Handler();
  }

  /** Initializes the CPU, AHB and APB buses clocks
  */
  RCC_ClkInitStruct.ClockType = RCC_CLOCKTYPE_HCLK|RCC_CLOCKTYPE_SYSCLK
                              |RCC_CLOCKTYPE_PCLK1|RCC_CLOCKTYPE_PCLK2;
  RCC_ClkInitStruct.SYSCLKSource = RCC_SYSCLKSOURCE_HSI;
  RCC_ClkInitStruct.AHBCLKDivider = RCC_SYSCLK_DIV1;
  RCC_ClkInitStruct.APB1CLKDivider = RCC_HCLK_DIV1;
  RCC_ClkInitStruct.APB2CLKDivider = RCC_HCLK_DIV1;

  if (HAL_RCC_ClockConfig(&RCC_ClkInitStruct, FLASH_LATENCY_0) != HAL_OK)
  {
    Error_Handler();
  }
}

void Error_Handler(void)
{
  __disable_irq();
  while (1)
  {
  }
}
